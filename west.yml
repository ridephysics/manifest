## west.yml
```yaml
manifest:
  defaults:
    remote: github
    revision: master

  remotes:
    - name: github
      url-base: ssh://git@github.com

  projects:
    - name: ridephysics/imulogger
      path: imulogger
      west-commands: scripts/west-commands.yml

    - name: ridephysics/sensoreval
      path: sensoreval
      west-commands: scripts/west-commands.yml

    - name: espressif/esp-idf
      path: external/esp-idf

    - name: M1cha/MQTT-C
      path: external/mqtt-c
      revision: eventloop

    - name: ridephysics/BMP280_driver
      path: external/bmp280

    - name: ridephysics/crosslog
      path: components/crosslog

    - name: ridephysics/crossi2c
      path: components/crossi2c

    - name: ridephysics/uev
      path: components/uev

    - name: ridephysics/usfs
      path: components/usfs

    - name: ridephysics/uftpd
      path: components/uftpd

  self:
    path: manifest

  configs:
    zephyr:
      disabled: true
```
